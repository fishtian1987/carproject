/*
*********************************************************************************************************
*	                                  
*	模块名称 : HMI驱动模块
*	文件名称 : HMI.c
*	版    本 : V1.3
*	说    明 : HMI驱动程序
*
*
*********************************************************************************************************
*/

#include "hmi.h"

/*
*********************************************************************************************************
*	函 数 名: HMISendb
*	功能说明: 字节发送函数
*	形    参：k:待发送字节
*	返 回 值: 无
*********************************************************************************************************
*/
void HMISendb(u8 k)		         
{
	u8 i=0;
	for(i=0;i<3;i++)
	{
		if(k!=0){USART6->DR = k;while((USART6->SR&0X40)==0);}
		else return ;
	} 
}

/*
*********************************************************************************************************
*	函 数 名: HMISendstart
*	功能说明: 确保串口HMI正常通信
*	形    参：无
*	返 回 值: 无
*********************************************************************************************************
*/
void HMISendstart(void)
{
	u8 i=0;
	USART6_TX_BUF[0]=0xff;
	USART6_TX_BUF[1]=0xff;
	USART6_TX_BUF[2]=0xff;
	
	for(i=0;i<3;i++)
	{
		USART_SendData(USART6, USART6_TX_BUF[i]);
		while(USART_GetFlagStatus(USART6,USART_FLAG_TC)!=SET);
	}
}

/*
*********************************************************************************************************
*	函 数 名: HMISends
*	功能说明: 字符串发送函数
*	形    参：buf1:待发送字符串
*	返 回 值: 无
*********************************************************************************************************
*/
void HMISends(char *buf1)		  
{
	u8 i=0;
	while(1)
	{
		if(buf1[i]!=0)
		{
			USART6->DR = (u8) buf1[i];
			while((USART6->SR&0X40)==0);
			i++;
		}
		else break;
	}
	for(i=0;i<3;i++)
	{
		USART6->DR = (u8)0XFF;
		while((USART6->SR&0X40)==0);
	}
	return ;
}
